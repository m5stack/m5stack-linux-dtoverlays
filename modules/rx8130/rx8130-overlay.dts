/dts-v1/;
/plugin/;

/ {
    compatible = "brcm,bcm2835";
    
    fragment@0 {
        target = <&i2c1>;
        __overlay__ {
            #address-cells = <1>;
            #size-cells = <0>;
            status = "okay";
            
            rx8130: rx8130@68 {
                compatible = "epson,rx8130";
                reg = <0x68>;
                status = "okay";
            };
        };
    };
};